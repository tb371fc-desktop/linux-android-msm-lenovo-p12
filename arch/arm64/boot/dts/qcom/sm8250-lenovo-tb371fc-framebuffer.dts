/dts-v1/;

#include "sm8250-lenovo-tb371fc.dts"

/*
 * Additional setup to get serial output over the framebuffer.
 * Intended to get the default `console=tty0` to recognize the
 * framebuffer and use it for log output.
 */

/ {
	chosen {
		bootargs = "console=tty0 clk_ignore_unused pd_ignore_unused";
		#address-cells = <2>;
		#size-cells = <2>;
		ranges; /* Allows children to map to main system memory */

		framebuffer0: framebuffer@9c000000 {
			compatible = "simple-framebuffer";
			reg = <0x0 0x9c000000 0x0 0x2300000>;
			width = <2944>;
			height = <1840>;
			stride = <(2944 * 4)>;
			format = "a8r8g8b8";
			status = "okay";

			/*
			 * Clocks and power-domains are omitted to prevent driver
			 * deferral. We rely on the bootloader's state and use
			 * clk_ignore_unused / pd_ignore_unused bootargs instead.
			 */
		};
	};
};
